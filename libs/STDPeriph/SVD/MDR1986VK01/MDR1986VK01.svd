# MDR1986VK01 register map
File version: 1.0.2
Registers are 32-bit, read-write, no defined reset value unless marked. A register's access mark holds for its fields unless they carry their own. Offsets are from the block's base; lines under a group give offsets from that group; [hi:lo] are bit positions; {n}, {i} and the like mark numbered series; 'fields as' and 'values as' point back to an identical list; <NAME> marks a mode.

## Memory map
0x21000000 MDR_ETH size 0x1000 — MDR_ETH description
0x21010000 MDR_USB size 0x1000 — MDR_USB description
0x2101007C MDR_USB_TAR0 size 0x1000 — MDR_USB_TAR0 description
0x21010084 MDR_USB_TAR1 size 0x1000 — MDR_USB_TAR1 description
0x2101008C MDR_USB_TAR2 size 0x1000 — MDR_USB_TAR2 description
0x21010094 MDR_USB_TAR3 size 0x1000 — MDR_USB_TAR3 description
0x21030000 GATE0 size 0x1000 — GATE0 description
0x21030080 GATE1 size 0x1000 — GATE1 description
0x40000000 MDR_CLK size 0x1000 — MDR_CLK description
0x40001000 MDR_BKP size 0x1000 — MDR_BKP description
0x40003000 MDR_FTMODE size 0x1000 — MDR_FTMODE description
0x40004000 MDR_WDT size 0x1000 — MDR_WDT description
0x40005000 MDR_ROM size 0x1000 — MDR_ROM description
0x40006000 MDR_FLASH size 0x1000 — MDR_FLASH description
0x40008000 MDR_RAMC0 size 0x1000 — MDR_RAMC0 description
0x40009000 MDR_RAMC1 size 0x1000 — MDR_RAMC1 description
0x4000A000 MDR_RAMD0 size 0x1000 — MDR_RAMD0 description
0x4000B000 MDR_RAMD1 size 0x1000 — MDR_RAMD1 description
0x4000C000 MDR_EBC size 0x1000 — MDR_EBC description
0x40080000 MDR_PORTA size 0x1000 — MDR_PORTA description
0x40081000 MDR_PORTB size 0x1000 — MDR_PORTB description
0x40082000 MDR_PORTC size 0x1000 — MDR_PORTC description
0x40083000 MDR_PORTD size 0x1000 — MDR_PORTD description
0x40086000 MDR_CANFD size 0x1000 — MDR_CANFD description
0x40087000 MDR_MIL1_STD_1553 size 0x1000 — MDR_MIL1_STD_1553 description
0x40089000 MDR_SSP0 size 0x1000 — MDR_SSP0 description
0x4008A000 MDR_SSP1 size 0x1000 — MDR_SSP1 description
0x4008B000 MDR_CAN0 size 0x1000 — MDR_CAN0 description
0x4008C000 MDR_CAN1 size 0x1000 — MDR_CAN1 description
0x4008D000 MDR_UART0 size 0x1000 — MDR_UART0 description
0x4008E000 MDR_UART1 size 0x1000 — MDR_UART1 description
0x4008F000 MDR_UART2 size 0x1000 — MDR_UART2 description
0x40090000 MDR_UART3 size 0x1000 — MDR_UART3 description
0x40091000 MDR_MIL0_STD_1553 size 0x1000 — MDR_MIL0_STD_1553 description
0x40093000 MDR_USB_RAM size 0x1000 — MDR_USB_RAM description
0x40094000 MDR_TIMER0 size 0x1000 — MDR_TIMER0 description
0x40095000 MDR_TIMER1 size 0x1000 — MDR_TIMER1 description
0x40096000 MDR_TIMER2 size 0x1000 — MDR_TIMER2 description
0x40097000 MDR_TIMER3 size 0x1000 — MDR_TIMER3 description
0x40098000 MDR_CAP0 size 0x1000 — MDR_CAP0 description
0x40099000 MDR_CAP1 size 0x1000 — MDR_CAP1 description
0x4009A000 MDR_CAP2 size 0x1000 — MDR_CAP2 description
0x4009B000 MDR_CAP3 size 0x1000 — MDR_CAP3 description
0x4009C000 MDR_QEP0 size 0x1000 — MDR_QEP0 description
0x4009D000 MDR_QEP1 size 0x1000 — MDR_QEP1 description
{0x4009E000+0x1000*n} MDR_PWM{n} size 0x1000 (n=0..8) — MDR_PWM{n} description
0x400A7000 MDR_ADC0 size 0x1000 — MDR_ADC0 description
0x400A8000 MDR_ADC1 size 0x1000 — MDR_ADC1 description
0x400A9000 MDR_ADC2 size 0x1000 — MDR_ADC2 description
0x400AA000 MDR_DAC0 size 0x1000 — MDR_DAC0 description
0x400AB000 MDR_DAC1 size 0x1000 — MDR_DAC1 description
0x400AC000 MDR_DAC2 size 0x1000 — MDR_DAC2 description
0x400AD000 MDR_DAC3 size 0x1000 — MDR_DAC3 description
0x400AE000 MDR_COMP0 size 0x1000 — MDR_COMP0 description
0x400AF000 MDR_COMP1 size 0x1000 — MDR_COMP1 description
0x400B0000 MDR_COMP2 size 0x1000 — MDR_COMP2 description
0x400B1000 MDR_COMP3 size 0x1000 — MDR_COMP3 description
0x400B2000 MDR_I2C size 0x1000 — MDR_I2C description
0x400B3000 MDR_CORDIC size 0x1000 — MDR_CORDIC description
0x400B5000 MDR_SDIO size 0x1000 — MDR_SDIO description
0x400B6000 MDR_CRC size 0x1000 — MDR_CRC description
0xE0042000 MDR_DMA size 0x1000 — MDR_DMA description
0xE0043000 MDR_SCR size 0x1000 — MDR_SCR description
0xE0044000 MDR_ICACHE size 0x1000 — MDR_ICACHE description
0xE0045000 MDR_DCACHE size 0x1000 — MDR_DCACHE description
